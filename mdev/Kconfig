## mdev/Kconfig
```kconfig
config VFIO_MDEV
	tristate "Mediated device driver framework"
	depends on VFIO
	default n
	help
	  Provides a framework to virtualize devices.
	  See Documentation/vfio-mediated-device.txt for more details.

	  If you don't know what do here, say N.

config VFIO_MDEV_DEVICE
	tristate "VFIO driver for Mediated devices"
	depends on VFIO && VFIO_MDEV
	default n
	help
	  VFIO based driver for Mediated devices.

config VFIO_MDEV_NET_DEVICE
	tristate "VFIO driver for Mediated network devices"
	depends on VFIO && VFIO_MDEV
	default n
	help
	  VFIO based driver for Mediated network devices.
```
